## sdkconfig.defaults.esp32s3
```kconfig
CONFIG_ESPTOOLPY_FLASHSIZE_16MB=y
CONFIG_ESPTOOLPY_FLASHMODE_QIO=y

CONFIG_ESP_DEFAULT_CPU_FREQ_MHZ_240=y

CONFIG_SPIRAM=y
CONFIG_SPIRAM_MODE_OCT=y
CONFIG_SPIRAM_SPEED_80M=y
CONFIG_SPIRAM_MALLOC_ALWAYSINTERNAL=512
CONFIG_SPIRAM_MALLOC_RESERVE_INTERNAL=65536
CONFIG_SPIRAM_MEMTEST=n
CONFIG_MBEDTLS_EXTERNAL_MEM_ALLOC=y

CONFIG_ESP_WIFI_STATIC_RX_BUFFER_NUM=3
CONFIG_ESP_WIFI_DYNAMIC_RX_BUFFER_NUM=6
CONFIG_ESP_WIFI_RX_BA_WIN=3
CONFIG_LWIP_TCPIP_RECVMBOX_SIZE=16
CONFIG_MBEDTLS_DYNAMIC_FREE_CONFIG_DATA=y

CONFIG_ESP32S3_INSTRUCTION_CACHE_32KB=y
CONFIG_ESP32S3_DATA_CACHE_LINE_64B=y

CONFIG_SR_WN_WN9_NIHAOXIAOZHI_TTS=y

CONFIG_ESP_SYSTEM_EVENT_TASK_STACK_SIZE=4096

CONFIG_USB_HOST_CONTROL_TRANSFER_MAX_SIZE=1536

# LVGL Graphics
CONFIG_LV_USE_SNAPSHOT=y
# ====================== 控制台串口配置（UART1，GPIO19/20）======================
# 启用自定义串口模式
CONFIG_ESP_CONSOLE_UART_CUSTOM=y
# 【最终选择】选UART1
CONFIG_ESP_CONSOLE_UART_CUSTOM_NUM_1=y
# 取消UART0
# CONFIG_ESP_CONSOLE_UART_CUSTOM_NUM_0 is not set
# 串口编号
CONFIG_ESP_CONSOLE_UART_NUM=1
# 引脚配置
CONFIG_ESP_CONSOLE_UART_TX_GPIO=19
CONFIG_ESP_CONSOLE_UART_RX_GPIO=20
# 波特率
CONFIG_ESP_CONSOLE_UART_BAUDRATE=115200
```
